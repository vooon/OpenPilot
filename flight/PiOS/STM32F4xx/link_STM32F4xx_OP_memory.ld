MEMORY
{
	FLASH (rx)    : ORIGIN = 0x08000000,        LENGTH = 0x100000
	SRAM (rwx)    : ORIGIN = 0x20000000,        LENGTH = 0x020000
	CCSRAM (rw)   : ORIGIN = 0x10000000,        LENGTH = 0x010000	
}
